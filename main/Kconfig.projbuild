## main/Kconfig.projbuild
```kconfig
menu "Project's Wifi Configuration"

	config ESP_WIFI_SSID
		string "WiFi SSID"
		default "ssid"
		help
			WiFi network's name.

	config ESP_WIFI_PASSWORD
		string "WiFi password"
		default "password"
		help
			WiFi password (WPA or WPA2).

	config ESP_MAXIMUM_RETRY
		int "Maximum connection attempts"
		default 5
		help
			Set the maximum number of connection attempts.
endmenu

menu "MQTT Configuration"

	config MQTT_SERVER_URI
		string "URI"
		default "mqtt://mqtt.eclipse.org"
		help
			MQTT Server URI.

	config MQTT_USERNAME
		string "Username"
		default "username-or-token"
		help
			MQTT Username or token.
endmenu

menu "Operation Mode"

	config BATTERY_MODE
		bool "System is in battery mode"
		default n
		help
			Wether the system operates in battery mode.
endmenu
```
